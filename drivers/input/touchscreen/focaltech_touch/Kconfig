## drivers/input/touchscreen/focaltech_touch/Kconfig
```kconfig
#
# Focaltech Touchscreen driver configuration
#

config TOUCHSCREEN_FTS_5426
    bool "Focaltech Touchscreen"
    default n
    help
      Say Y here if you have Focaltech touch panel.
      If unsure, say N.
      
config TOUCHSCREEN_FTS_5426_DIRECTORY
    string "Focaltech ts directory name"
    default "focaltech_touch"
    depends on TOUCHSCREEN_FTS_5426
    
```

## drivers/misc/nxp-pn7462/Kconfig
```kconfig
config NFC_NXP_PN7462
	tristate "NXP PN7462 based driver"
	depends on I2C
	select CRC_CCITT
	default n
	---help---
	  NXP PN7462 driver based on I2C.
	  This is a driver to provides I2C access to PN7462 NFC Controller devices 

	  To compile this driver as a module, choose m here. The module will
	  be called pn7462_i2c.
	  Say N if unsure.
```

## drivers/net/wireless/rtl8192es/Kconfig
```kconfig
config RTL8192ES
	tristate "Realtek 8192E SDIO WiFi"
	---help---
	  Help message of RTL8192ES
```
